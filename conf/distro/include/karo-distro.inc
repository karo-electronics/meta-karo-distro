## conf/distro/include/karo-distro.inc
```bitbake
POKY_DISTRO ??= "poky"
require conf/distro/${POKY_DISTRO}.conf
require ${@ "gpu_vivante.inc" if 'stm32mpcommon' in d.getVar('MACHINEOVERRIDES').split(":") else ""}
require ${@ "karo-nxp.inc" if 'use-nxp-bsp' in d.getVar('MACHINEOVERRIDES').split(":") else ""}
require ${@bb.utils.contains('DISTRO_FEATURES', 'systemd', "systemd.inc", "", d)}

DISTRO_VERSION = "${PREFERRED_VERSION_linux-karo}-${DISTRO_CODENAME}"

POKY_DEFAULT_DISTRO_FEATURES:remove = "\
    largefile \
    opengl \
    ptest \
    vulkan \
    wayland \
"

DISTRO_FEATURES_DEFAULT ?= "\
    acl \
    alsa \
    argp \
    dhcpcd \
    ext2 \
    ipv4 \
    largefile \
    ldconfig \
    pam \
    nfs \
    seccomp \
    telnet-login \
    u-boot-fw-utils \
    usbgadget \
    usbhost \
    vfat \
    xattr \
"
DISTRO_FEATURES_DEFAULT:append:mx9-nxp-bsp = " edac"

ethifname() {
    iface="$1"
    if ${@ "false" if 'use-mainline-bsp' in d.getVar('MACHINEOVERRIDES').split(':') else "true"};then
        echo "$iface"
    elif ${@ bb.utils.contains('DISTRO_FEATURES', 'systemd', "true", "false", d)};then
        echo "$iface" | sed s/eth/end/
    else
        echo "$iface"
    fi
}

# for fw_printenv/fw_setenv
UBOOT_INITIAL_ENV ?= "u-boot-initial-env"

IMAGE_CLASSES:remove = "image_populate_mfgtool"
IMAGE_NAME_SUFFIX = ""

DISTRO_FEATURES_DEFAULT:append:stm32mp2 = " csi-camera imx219"
DISTRO_FEATURES_DEFAULT:append:qsmp-1570w = " wifi bluetooth bcm4373"
DISTRO_FEATURES_DEFAULT:append:qsmp-1530w = " wifi bluetooth bcm4373"

VIRTUAL-RUNTIME_base-utils-hwclock = "util-linux-hwclock"
VIRTUAL-RUNTIME_dev_manager ??= "udev"

VOLATILE_LOG_DIR ?= "no"

MACHINE_FIRMWARE:remove = "${@ bb.utils.contains('DISTRO_FEATURES', 'wifi', "", "linux-firmware-ath10k", d)}"

NETWORK_INTERFACES ??= "${@bb.utils.contains('MACHINE_FEATURES', 'stm-tsn-swch', "eth0 br0 sw0ep", "eth0", d)}"
NETWORK_INTERFACES_AUTO ??= "${@bb.utils.contains('MACHINE_FEATURES', 'stm-tsn-swch', "eth0", \
                             d.getVar('NETWORK_INTERFACES'), d)}"
DEFAULT_ETHERNET_MAIN_TSN_BRIDGE_INTERFACE ??= "${@bb.utils.contains('DISTRO_FEATURES', 'systemd', 'end0', 'eth0', d)}"

# convert update alternatives to relative symlinks
INHERIT += "${@bb.utils.contains('DISTRO_FEATURES', 'alternatives-symlinks-relative', 'update-alternatives-relative', '', d)}"

# CRA compliance support
# Create SPDX 3.0 SBOM and embed vulnerability metadata
INHERIT:remove = "create-spdx"
INHERIT += "create-spdx-3.0"
SPDX_INCLUDE_VEX = "current"
INHERIT += "vex"
```

## conf/distro/include/karo-nxp.inc
```bitbake
PREFERRED_PROVIDER_opencl-headers = "imx-gpu-viv"

# override default settings from meta-imx/.../imx-base-extend.inc ...
GSTREAMER_VERSION ?= "1.22.0.imx"
PREFERRED_VERSION_gstreamer1.0:mx8-nxp-bsp = "${GSTREAMER_VERSION}"
PREFERRED_VERSION_gstreamer1.0-plugins-base:mx8-nxp-bsp = "${GSTREAMER_VERSION}"
PREFERRED_VERSION_gstreamer1.0-plugins-good:mx8-nxp-bsp = "${GSTREAMER_VERSION}"
PREFERRED_VERSION_gstreamer1.0-plugins-bad:mx8-nxp-bsp = "${GSTREAMER_VERSION}"
PREFERRED_VERSION_gstreamer1.0-rtsp-server:mx8-nxp-bsp = "${GSTREAMER_VERSION}"
PREFERRED_VERSION_gstreamer1.0:mx9-nxp-bsp = "${GSTREAMER_VERSION}"
PREFERRED_VERSION_gstreamer1.0-plugins-base:mx9-nxp-bsp = "${GSTREAMER_VERSION}"
PREFERRED_VERSION_gstreamer1.0-plugins-good:mx9-nxp-bsp = "${GSTREAMER_VERSION}"
PREFERRED_VERSION_gstreamer1.0-plugins-bad:mx9-nxp-bsp = "${GSTREAMER_VERSION}"
PREFERRED_VERSION_gstreamer1.0-rtsp-server:mx9-nxp-bsp = "${GSTREAMER_VERSION}"
# ... and meta-freescale/.../imx-base.inc
PREFERRED_VERSION_gst-devtools:mx8-nxp-bsp              = "${GSTREAMER_VERSION}"
PREFERRED_VERSION_gstreamer1.0-libav:mx8-nxp-bsp        = "${GSTREAMER_VERSION}"
PREFERRED_VERSION_gstreamer1.0-plugins-ugly:mx8-nxp-bsp = "${GSTREAMER_VERSION}"
PREFERRED_VERSION_gstreamer1.0-python:mx8-nxp-bsp       = "${GSTREAMER_VERSION}"
PREFERRED_VERSION_gstreamer1.0-rtsp-server:mx8-nxp-bsp  = "${GSTREAMER_VERSION}"
PREFERRED_VERSION_gstreamer1.0-vaapi:mx8-nxp-bsp        = "${GSTREAMER_VERSION}"
PREFERRED_VERSION_gst-devtools:mx9-nxp-bsp              = "${GSTREAMER_VERSION}"
PREFERRED_VERSION_gstreamer1.0-libav:mx9-nxp-bsp        = "${GSTREAMER_VERSION}"
PREFERRED_VERSION_gstreamer1.0-plugins-ugly:mx9-nxp-bsp = "${GSTREAMER_VERSION}"
PREFERRED_VERSION_gstreamer1.0-python:mx9-nxp-bsp       = "${GSTREAMER_VERSION}"
PREFERRED_VERSION_gstreamer1.0-rtsp-server:mx9-nxp-bsp  = "${GSTREAMER_VERSION}"
PREFERRED_VERSION_gstreamer1.0-vaapi:mx9-nxp-bsp        = "${GSTREAMER_VERSION}"

DISTRO_FEATURES_DEFAULT:append:mx8-nxp-bsp  = " dsi83"
DISTRO_FEATURES_DEFAULT:append:mx8mp-nxp-bsp  = " flexcan"
DISTRO_FEATURES_DEFAULT:append:tx8m = " pcie"
DISTRO_FEATURES_DEFAULT:append:qs8m = " csi-camera imx219 raspi-display tc358867"
DISTRO_FEATURES_DEFAULT:append:qs93 = " csi-camera imx219"
DISTRO_FEATURES_DEFAULT:append:qsxm = " basler csi-camera imx219 pcie raspi-display tc358867"
DISTRO_FEATURES_DEFAULT:append:qsxp = " basler csi-camera pcie raspi-display tc358867"
DISTRO_FEATURES_DEFAULT:append:tx8p = " lvds pcie"

# mask out sysvinit recipes from meta-imx layer
BBMASK:append = " .*/meta-imx/.*/sysvinit/.*"
# mask out silly weston-init.bbappend from meta-imx layer
BBMASK:append = " .*/meta-imx/.*/weston-init.bbappend"
BBMASK:append = " .*/meta-imx/.*/xserver-xorg_%.bbappend"
```

## conf/distro/include/systemd.inc
```bitbake
DISTRO_FEATURES:remove = "sysvinit"
INIT_MANAGER = "systemd"
IMAGE_FEATURES:remove = "read-only-rootfs"
```

## conf/layer.conf
```bitbake
# We have a conf and classes directory, add to BBPATH
BBPATH .= ":${LAYERDIR}"

# We have a packages directory, add to BBFILES
BBFILES += "\
        ${LAYERDIR}/recipes-*/*/*.bb \
        ${LAYERDIR}/recipes-*/*/*.bbappend \
        ${LAYERDIR}/recipes-*/*/*/*.bb \
        ${LAYERDIR}/recipes-*/*/*/*.bbappend \
"
BBMASK:append:use-mainline-bsp = "\
        .*/recipes-karo-nxp/.* \
        .*/dynamic-layers/qt6-layer/recipes-fsl/.*/.* \
"

BBFILE_COLLECTIONS += "karo-distro"
BBFILE_PATTERN_karo-distro := "^${LAYERDIR}/"
BBFILE_PRIORITY_karo-distro = "6"
BBFILE_PRIORITY_karo-distro:use-nxp-bsp = "11"

LAYERDEPENDS_karo-distro:use-mainline-bsp = "karo"
LAYERDEPENDS_karo-distro:use-nxp-bsp = "karo-nxp"
LAYERSERIES_COMPAT_karo-distro = "scarthgap"

FILESYSTEM_PERMS_TABLES = "meta/files/fs-perms.txt"

BBFILES_DYNAMIC += " \
        imx-machine-learning:${LAYERDIR}/dynamic-layers/imx-machine-learning/recipes-nnstreamer/*.bbappend \
        imx-machine-learning:${LAYERDIR}/dynamic-layers/imx-machine-learning/recipes-nnstreamer/nnshark/*.bbappend \
        imx-machine-learning:${LAYERDIR}/dynamic-layers/imx-machine-learning/recipes-fsl/packagegroup/*.bbappend \
        qt6-layer:${LAYERDIR}/dynamic-layers/qt6-layer/recipes-qt/qt6/*.bbappend \
        qt6-layer:${LAYERDIR}/dynamic-layers/qt6-layer/recipes-fsl/packagegroup/*.bbappend \
        rauc:${LAYERDIR}/dynamic-layers/rauc/recipes-core/rauc/*.bbappend \
        rauc:${LAYERDIR}/dynamic-layers/rauc/recipes-core/rauc/*.bb \
        rauc:${LAYERDIR}/dynamic-layers/rauc/recipes-core/bundles/*.bbappend \
        rauc:${LAYERDIR}/dynamic-layers/rauc/recipes-core/bundles/*.bb \
        freescale-layer:${LAYERDIR}/dynamic-layers/freescale-layer/recipes-core/udev/udev-rules-imx.bbappend \
        freescale-layer:${LAYERDIR}/dynamic-layers/freescale-layer/recipes-multimedia/gstreamer/*.bb \
        freescale-layer:${LAYERDIR}/dynamic-layers/freescale-layer/recipes-multimedia/gstreamer/*.bbappend \
        stm-tsn-base:${LAYERDIR}/dynamic-layers/stm-tsn-base/*/*/*.bbappend \
"

BBMASK:append = " \
    .*/meta-st/meta-st-stm32mp-tsn-swch/recipes-st/images/.*.bbappend \
    .*/meta-st/meta-st-stm32mp-tsn-swch/recipes-bsp/u-boot/.*.bbappend \
    .*/meta-st/meta-st-stm32mp-tsn-swch/recipes-bsp/tools/.*.bbappend \
"
```
