## conf/distro/karo-minimal.conf
```bitbake
require include/karo-distro.inc

DISTRO = "karo-minimal"
DISTRO_NAME = "karo-minimal (Ka-Ro Linux BSP with minimal read-only rootfs)"

DISTRO_FEATURES:remove = " \
    gobject-introspection-data \
    multiarch \
    pulseaudio \
"

DISTRO_FEATURES_OPTED_OUT += " \
    gobject-introspection-data \
    pulseaudio \
"

MACHINE_EXTRA_RRECOMMENDS:remove = "udev-rules-imx"
```

## conf/distro/karo-wayland.conf
```bitbake
require include/karo-distro.inc

DISTRO = "karo-wayland"
DISTRO_NAME = "karo-wayland (Ka-Ro Linux BSP with wayland backend)"

# add support for wayland
DISTRO_FEATURES:append = " \
    opengl \
    vulkan \
    wayland \
"

# add support for ml image
DISTRO_FEATURES:append = " gobject-introspection-data"
```

## conf/distro/karo-xwayland.conf
```bitbake
require karo-wayland.conf

DISTRO = "karo-xwayland"
DISTRO_NAME = "karo-xwayland (Ka-Ro Linux BSP with xwayland backend)"

# add support for xwayland
DISTRO_FEATURES:append = " \
    x11 \
    pam \
"

PACKAGECONFIG:append:pn-weston      = " rdp"
PACKAGECONFIG:append:pn-weston-init = " rdp"
```
