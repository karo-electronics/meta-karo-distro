## conf/distro/karo-minimal.conf
```bitbake
require conf/distro/include/karo-distro.inc

DISTRO = "karo-minimal"
DISTRO_NAME = "karo-minimal (Ka-Ro Linux BSP with minimal read-only rootfs)"
DISTRO_VERSION = "5.10-${DISTRO_CODENAME}"

DISTRO_FEATURES:remove = " \
                          gobject-introspection-data \
                          multiarch \
                          pulseaudio \
"

DISTRO_FEATURES_BACKFILL_CONSIDERED += " \
                                        gobject-introspection-data \
                                        pulseaudio \
"

# kernelfeatures not needed in minimal
DISTRO_FEATURES_DEFAULT:remove = " \
                                  csi-camera \
                                  imx219 \
"

MACHINE_EXTRA_RRECOMMENDS:remove = "imx-m4-demos"
```

## conf/distro/karo-wayland.conf
```bitbake
require include/karo-distro.inc

DISTRO = "karo-wayland"
DISTRO_NAME = "karo-wayland (Ka-Ro Linux BSP with wayland backend)"

# mask out .bbappends from karo-minimal distro
BBMASK:append = " .*/recipes-karo-minimal/.*"

# add support for wayland
DISTRO_FEATURES:append = " \
    opengl \
    vulkan \
    wayland \
"

DISTRO_FEATURES_DEFAULT:append = " vivante_gpu"
```

## conf/distro/karo-x11.conf
```bitbake
require include/karo-distro.inc

DISTRO = "karo-x11"
DISTRO_NAME = "karo-x11 (Ka-Ro Linux BSP with X11 support)"

# mask out .bbappends from karo-minimal distro
BBMASK:append = " .*/recipes-karo-minimal/.*"

# add support for X11
DISTRO_FEATURES:append = " \
                          opengl \
                          vulkan \
                          x11 \
"
```

## conf/distro/karo-xwayland.conf
```bitbake
require conf/distro/include/karo-distro.inc

DISTRO = "karo-xwayland"
DISTRO_NAME = "karo-xwayland (Ka-Ro Linux BSP with xwayland backend)"

# mask out .bbappends from karo-minimal distro
BBMASK:append = " .*/recipes-karo-minimal/.*"

# add support for xwayland
DISTRO_FEATURES:append = " \
                          opengl \
                          vulkan \
                          wayland \
                          x11 \
                          pam \
"
```
